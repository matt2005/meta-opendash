## conf/bblayers.conf.sample
```bitbake
# POKY_BBLAYERS_CONF_VERSION is increased each time build/conf/bblayers.conf
# changes incompatibly
POKY_BBLAYERS_CONF_VERSION = "2"

BBPATH = "${TOPDIR}"
BBFILES ?= ""

BBLAYERS ?= " \
  ${HOME}/yocto/opendash/poky-dunfell/meta \
  ${HOME}/yocto/opendash/poky-dunfell/meta-poky \
  ${HOME}/yocto/opendash/poky-dunfell/meta-openembedded/meta-oe \
  ${HOME}/yocto/opendash/poky-dunfell/meta-openembedded/meta-multimedia \
  ${HOME}/yocto/opendash/poky-dunfell/meta-openembedded/meta-networking \
  ${HOME}/yocto/opendash/poky-dunfell/meta-openembedded/meta-perl \
  ${HOME}/yocto/opendash/poky-dunfell/meta-openembedded/meta-python \
  ${HOME}/yocto/opendash/poky-dunfell/meta-qt5 \
  ${HOME}/yocto/opendash/poky-dunfell/meta-raspberrypi \
  ${HOME}/yocto/opendash/poky-dunfell/meta-security \
  ${HOME}/yocto/opendash/poky-dunfell/meta-crankshaft/meta-crankshaft \
  ${HOME}/yocto/opendash/poky-dunfell/meta-opendash \
  ${HOME}/yocto/opendash/poky-dunfell/meta-mender/meta-mender-core \
  ${HOME}/yocto/opendash/poky-dunfell/meta-mender/meta-mender-raspberrypi \
"
```

## conf/layer.conf
```bitbake
# We have a conf and classes directory, add to BBPATH
BBPATH .= ":${LAYERDIR}"

# We have recipes-* directories, add to BBFILES
BBFILES += "${LAYERDIR}/recipes-*/*/*.bb \
            ${LAYERDIR}/recipes-*/*/*.bbappend \
            ${LAYERDIR}/images/*.bb"

BBFILE_COLLECTIONS += "meta-opendash"
BBFILE_PATTERN_meta-opendash = "^${LAYERDIR}/"
BBFILE_PRIORITY_meta-opendash = "11"

LAYERDEPENDS_meta-opendash = "core openembedded-layer qt5-layer meta-openauto"
LAYERSERIES_COMPAT_meta-opendash = "warrior zeus dunfell gatesgarth hardknott"
```

## conf/local.conf.sample
```bitbake
# Local configuration for meta-rpi images
# Yocto Project 3.1 Poky distribution [dunfell] branch
# This is a sysvinit system

# mask wireguard from meta-openembedded/meta-networking
# use version in meta-jumpnow to support kernels < 5.6
# with wireguard-linux-compat
BBMASK = "meta-networking/recipes-kernel/wireguard"

LICENSE_FLAGS_WHITELIST = "commercial"

DISTRO_FEATURES_append = " pulseaudio bluetooth ext2 usbhost ${DISTRO_FEATURES_LIBC} systemd "


PREFERRED_PROVIDER_jpeg = "libjpeg-turbo"
PREFERRED_PROVIDER_jpeg-native = "libjpeg-turbo-native"

PREFERRED_PROVIDER_udev = "eudev"

VIRTUAL-RUNTIME_init_manager = "systemd"
VIRTUAL-RUNTIME_initscripts = ""

MACHINE_FEATURES_remove = "apm"

IMAGE_FSTYPES = "rpi-sdimg"

MACHINE = "raspberrypi4-64"

KERNEL_IMAGETYPE = "Image"

# uncomment for kernels < 5.6
WIREGUARD_COMPAT = "1"

DISABLE_OVERSCAN = "1"
# ENABLE_UART = "1"
SERIAL_CONSOLES = ""

# default to 5.4
PREFERRED_VERSION_linux-raspberrypi = "5.4.%"
# PREFERRED_VERSION_linux-raspberrypi = "4.19.%"

# DL_DIR = "/src/oe"
# SSTATE_DIR = "/oe8/rpi64/sstate-cache"
# TMPDIR = "/oe8/rpi64/tmp-zeus"

DISTRO = "poky"
PACKAGE_CLASSES = "package_ipk"

# i686 or x86_64
SDKMACHINE = "x86_64"

# for no root passwd uncomment the following and comment the two extra user lines
# EXTRA_IMAGE_FEATURES = "debug-tweaks"

# for a root passwd, change jumpnowtek below to your password
INHERIT += "extrausers"
EXTRA_USERS_PARAMS = "\
	usermod -P raspberry root; \
	useradd -P raspberry -G sudo pi; \
	groupadd netdev; \
"

# this will force root to change password on first login
# INHERIT += "chageusers"
# CHAGE_USERS_PARAMS = "chage -d0 root; "

USER_CLASSES = "image-mklibs image-prelink"
PATCHRESOLVE = "noop"
RM_OLD_IMAGE = "1"
# INHERIT += "rm_work"
CONF_VERSION = "1"
PREFERRED_VERSION_aasdk = "2.1.0"
RPI_USE_U_BOOT = "1"

# These are simply to align with how the "stock" RPi machines are
# configured.
MENDER_PARTITION_ALIGNMENT = "4194304"
MENDER_BOOT_PART_SIZE_MB = "40"

# rpi-base.inc removes these as they are normally installed on to the
# vfat boot partition. To be able to update the Linux kernel Mender
# uses an image that resides on the root file system and below line
# ensures that they are installed to /boot
IMAGE_INSTALL_append = " kernel-image kernel-devicetree"

# Mender will build an image called `sdimg` which shall be used instead
# of the `rpi-sdimg`.
IMAGE_FSTYPES_remove += " rpi-sdimg"

# Use the same type here as specified in ARTIFACTIMG_FSTYPE to avoid
# building an unneeded image file.
SDIMG_ROOTFS_TYPE = "ext4"
```
